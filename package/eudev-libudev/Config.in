## package/eudev-libudev/Config.in
```kconfig
config BR2_PACKAGE_EUDEV_LIBUDEV
	bool "eudev-libudev"
	depends on BR2_USE_MMU # uses fork()
	depends on BR2_USE_WCHAR # needs C99 compiler
	depends on !BR2_STATIC_LIBS # dlfcn.h
	select BR2_PACKAGE_HAS_UDEV
	help
	  eudev is a fork of systemd-udev with the goal of obtaining
	  better compatibility with existing software such as OpenRC and
	  Upstart, older kernels, various toolchains and anything else
	  required by users and various distributions.

	  https://github.com/eudev-project/eudev

if BR2_PACKAGE_EUDEV_LIBUDEV

config BR2_PACKAGE_PROVIDES_UDEV
	default "eudev-libudev"

endif

comment "eudev needs a toolchain w/ wchar, dynamic library"
	depends on BR2_USE_MMU
	depends on !BR2_USE_WCHAR || BR2_STATIC_LIBS
```
